## conf/layer.conf
```bitbake
BBPATH .= ":${LAYERDIR}"
BBFILES += "${LAYERDIR}/recipes-*/*/*.bb ${LAYERDIR}/recipes-*/*/*.bbappend"
BBFILE_COLLECTIONS += "msu-de10-nano"
BBFILE_PATTERN_msu-de10-nano = "^${LAYERDIR}/"
BBFILE_PRIORITY_msu-de10-nano = "6"
LAYERDEPENDS_msu-de10-nano = "core meta-intel-fpga"
LAYERSERIES_COMPAT_msu-de10-nano = "scarthgap"
```

## conf/machine/de10-nano-audio-mini.conf
```bitbake
#@TYPE: Machine
#@NAME: de10-nano-audio-mini
#@DESCRIPTION: Machine configuration for the DE10 Nano with Audio Mini SD Card Boot" 

# Include base SOCFPGA configuration and UBIFS filesystem support
require conf/machine/include/socfpga.inc
require conf/machine/include/ubifs.inc

# Setup Configuration
# Default deployment method - can be "sd" for SD card or "tftp-nfs" for network boot
DE10_NANO_DEPLOY_CONFIG ??= "sd"
# Combine machine name with deployment config to create unique configuration identifier
DE10_NANO_CONFIG ??= "${MACHINE}-${DE10_NANO_DEPLOY_CONFIG}"

DE10_NANO_STATIC_IP ?= "192.168.2.20"
DE10_NANO_GATEWAY ?= "0.0.0.0"
DE10_NANO_MASK ?= "255.255.255.0"
DE10_NANO_ETH_ADAPTER ?= "eth0"
DE10_NANO_DHCP_STATUS ?= "off"

DE10_NANO_NFS_IP ?= "192.168.2.10"
DE10_NANO_NFS_PORT ?= "2049"
DE10_NANO_NFS_DIR ?= "/srv/nfs/shared/de10nano"
DE10_NANO_TFTP_DIR ?= "/srv/tftp"

DE10_NANO_BASE_DEVICE_TREE = "de10-nano-audio-mini-base"
DE10_NANO_BASE_DTB = "${DE10_NANO_BASE_DEVICE_TREE}.dtb"
DE10_NANO_BASE_DTS = "${DE10_NANO_BASE_DEVICE_TREE}.dts"

DE10_NANO_CUSTOM_DEVICE_TREE ?= "${DE10_NANO_BASE_DEVICE_TREE}"
DE10_NANO_CUSTOM_DTB ?= "${DE10_NANO_CUSTOM_DEVICE_TREE}.dtb"
DE10_NANO_CUSTOM_DTS ?= "${DE10_NANO_CUSTOM_DEVICE_TREE}.dts"
DE10_NANO_CUSTOM_DTS_PATH ?= ""

QUARTUS_ROOTDIR ?= ""
DE10_NANO_HW_PROJECT ?= ""
DE10_NANO_HW_PROJECT_HPS_DIR ?= "${DE10_NANO_HW_PROJECT}/hps_isw_handoff"
DE10_NANO_HPS_NAME ?= ""
SOC_EDS_DIR ?= ""
DE10_NANO_RBF_FILE ?= ""

CUSTOM_UBOOT_CONFIG ?= ""
CUSTOM_UBOOT_CONFIG_PATH ?= ""

# U-Boot Configuration
# Set the U-Boot configuration based on the deployment method
UBOOT_CONFIG ??= "${DE10_NANO_CONFIG}"
# U-Boot defconfig for SD card boot method
UBOOT_CONFIG[de10-nano-audio-mini-sd] = "de10_nano_audio_mini_sd_defconfig"
# U-Boot defconfig for TFTP/NFS network boot method
UBOOT_CONFIG[de10-nano-audio-mini-tftp-nfs] = "de10_nano_audio_mini_tftp_nfs_defconfig"
UBOOT_CONFIG[de10-nano-audio-mini-custom] = "${CUSTOM_UBOOT_CONFIG}"


# Kernel and bootloader preferences
# Use the SOCFPGA-specific long-term support kernel
PREFERRED_PROVIDER_virtual/kernel = "linux-socfpga-lts"
# Prefer kernel version 6.6.x (% allows any patch version)
PREFERRED_VERSION_linux-socfpga-lts = "6.6%"
# Use U-Boot as the bootloader
PREFERRED_PROVIDER_virtual/bootloader = "u-boot-socfpga"
PREFERRED_PROVIDER_virtual/dtb = "de10-nano-audio-mini-devicetree"
PREFERRED_PROVIDER_virtual/dtbs = "de10-nano-audio-mini-devicetree"

# System configuration
# Use systemd as the init system (alternative would be SysVinit)
INIT_MANAGER ?= "systemd"

# Kernel machine type for Cyclone V FPGA family
KMACHINE = "cyclone5"

# Device Tree Configuration
# Custom device tree handled by separate recipe: de10-nano-audio-mini-devicetree
# KERNEL_DEVICETREE ?= "de10-nano-audio-mini-base.dtb"


# Serial Console Configuration
# Configure serial console at 115200 baud rate on ttyS0 (UART0)
SERIAL_CONSOLES ?= "115200;ttyS0"

# U-Boot ExtLinux Configuration
# Enable U-Boot ExtLinux support for boot menu
UBOOT_EXTLINUX ?= "1"
# Define available boot labels (menu entries)
UBOOT_EXTLINUX_LABELS ?= "default"
# Set the default boot label name
UBOOT_EXTLINUX_DEFAULT_LABEL ?= "DE10 Nano Audio Mini ${DE10_NANO_DEPLOY_CONFIG} Build"

# Console configuration for kernel command line
UBOOT_EXTLINUX_CONSOLE ?= "console=ttyS0,115200n8"
# Root filesystem location (partition 2 on SD card)
UBOOT_EXTLINUX_ROOT ?= "${@'root=/dev/nfs nfsroot=' + d.getVar('DE10_NANO_NFS_IP') + ':' + d.getVar('DE10_NANO_NFS_DIR') + ',port=' + d.getVar('DE10_NANO_NFS_PORT') + ',nfsvers=3,tcp' if d.getVar('DE10_NANO_DEPLOY_CONFIG') == 'tftp-nfs' else 'root=/dev/mmcblk0p2'}"

# Human-readable description for the boot menu
UBOOT_EXTLINUX_MENU_DESCRIPTION:default ?= "DE10 Nano Audio Mini ${DE10_NANO_DEPLOY_CONFIG} Build"

# Path to kernel image relative to boot partition
UBOOT_EXTLINUX_KERNEL_IMAGE:default ?= "../${KERNEL_IMAGETYPE}"

# Directory containing device tree files
UBOOT_EXTLINUX_FDTDIR:default ?= "../intel/socfpga/"
# Additional kernel command line arguments
UBOOT_EXTLINUX_KERNEL_ARGS ?= "${@'earlycon ip=' + d.getVar('DE10_NANO_STATIC_IP') + ':' + d.getVar('DE10_NANO_NFS_IP') + ':' + d.getVar('DE10_NANO_GATEWAY') + ':' + d.getVar('DE10_NANO_MASK') + '::' + d.getVar('DE10_NANO_ETH_ADAPTER') + ':' + d.getVar('DE10_NANO_DHCP_STATUS') + ' rw' if d.getVar('DE10_NANO_DEPLOY_CONFIG') == 'tftp-nfs' else 'earlycon rootwait rw ip=' + d.getVar('DE10_NANO_STATIC_IP') + '::' + d.getVar('DE10_NANO_GATEWAY') + ':' + d.getVar('DE10_NANO_MASK') + '::' + d.getVar('DE10_NANO_ETH_ADAPTER') + ':' + d.getVar('DE10_NANO_DHCP_STATUS')}"



# JFFS2 Filesystem Configuration
# Set erase block size for JFFS2 to 64KB (0x10000)
EXTRA_IMAGECMD:jffs2 ?= "-e 0x10000"

# Boot Partition Files Configuration
# Define files to include in the boot partition of the SD card image
IMAGE_BOOT_FILES ?= "\
	devicetree/${DE10_NANO_CUSTOM_DTB};intel/socfpga/${DE10_NANO_CUSTOM_DTB} \
	${KERNEL_IMAGETYPE} \
	extlinux.conf;extlinux/extlinux.conf \
	soc_system.rbf;bitstream/soc_system.rbf \
	"

# Image Generation Configuration
# Use the Cyclone5/Arria5 WIC kickstart file for SD card image layout
WKS_FILE ?= "de10-nano-${DE10_NANO_DEPLOY_CONFIG}-build.wks"
# Add WIC (OpenEmbedded Image Creator) format to generated image types
IMAGE_FSTYPES:append = " wic"

# Package Management Configuration
# Add APT and DPKG package managers to the root filesystem
IMAGE_INSTALL:append = " apt dpkg audiomini-drivers"
# Add Debian package feed URI for additional packages
PACKAGE_FEED_URIS:append = " http://mirror.0x.sg/debian/"
# Set base path for package feeds (RPM format)
PACKAGE_FEED_BASE_PATHS:append = " rpm"
# Define supported architectures for package feeds
PACKAGE_FEED_ARCHS:append = " all armhf"

# Use Debian package format (.deb) for package management
PACKAGE_CLASSES ?= "package_deb"

# Additional Image Features
# Enable development and debugging features in the image
EXTRA_IMAGE_FEATURES ?= "debug-tweaks tools-sdk tools-debug package-management"

APTGET_ADD_USERS ?= "user:password:shell"
```

## meta-my-audiomini-combfilter/conf/layer.conf
```bitbake
# We have a conf and classes directory, add to BBPATH
BBPATH .= ":${LAYERDIR}"

# We have recipes-* directories, add to BBFILES
BBFILES += "${LAYERDIR}/recipes-*/*/*.bb \
            ${LAYERDIR}/recipes-*/*/*.bbappend"

BBFILE_COLLECTIONS += "meta-my-audiomini-combfilter"
BBFILE_PATTERN_meta-my-audiomini-combfilter = "^${LAYERDIR}/"
BBFILE_PRIORITY_meta-my-audiomini-combfilter = "6"

LAYERDEPENDS_meta-my-audiomini-combfilter = "core"
LAYERSERIES_COMPAT_meta-my-audiomini-combfilter = "scarthgap"
```

## wic/de10-nano-tftp-nfs-build.wks
```
# short-description: Create an SD card image for the DE10 Nano for a TFTP/NFS Boot
# long-description: Create an SD card image for the DE10 Nano for a TFTP/NFS Boot.
# Boot files are located in the first vfat partition and u-Boot is located in
# the second partition.

part --source bootimg-partition --ondisk mmcblk --fstype=vfat --mkfs-extraopts "-F 32" --label boot --active --align 1024 --fixed-size 500M --system-id b
part --source rawcopy --sourceparams="file=u-boot-with-spl.sfp" --ondisk mmcblk --system-id=a2 --align 1024 --fixed-size 10M
```
